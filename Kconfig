## Kconfig
```kconfig
config MT41RP_STATUS_LEDS
    bool "充電中は緑、ペアリング中は青の点滅で XIAO の LED を光らせる"
    depends on DT_HAS_ZMK_MT41RP_STATUS_LEDS_ENABLED
    depends on ZMK_BLE
    select GPIO
    default y

config MT41RP_STATUS_LEDS_BLINK_MS
    int "ペアリング中の点滅の間隔（ms）"
    depends on MT41RP_STATUS_LEDS
    default 500

config MT41RP_STATUS_LEDS_POLL_MS
    int "ペアリング中でないときに状態を確認する間隔（ms）"
    depends on MT41RP_STATUS_LEDS
    default 1000
```

## config/boards/shields/mt41rp_split/Kconfig.defconfig
```kconfig
# 右手（トラックボール側）をセントラルにする
if SHIELD_MT41RP_SPLIT_RIGHT

config ZMK_KEYBOARD_NAME
    default "mt41rp"

config ZMK_SPLIT_ROLE_CENTRAL
    default y

config PAW3222
    default y

endif

if SHIELD_MT41RP_SPLIT_LEFT || SHIELD_MT41RP_SPLIT_RIGHT

config ZMK_SPLIT
    default y

config ZMK_POINTING
    default y

endif
```

## config/boards/shields/mt41rp_split/Kconfig.shield
```kconfig
config SHIELD_MT41RP_SPLIT_LEFT
    def_bool $(shields_list_contains,mt41rp_split_left)

config SHIELD_MT41RP_SPLIT_RIGHT
    def_bool $(shields_list_contains,mt41rp_split_right)
```

## dts/bindings/zmk,mt41rp-status-leds.yaml
```yaml
description: |
  mt-41rp split の状態 LED。
  バッテリーに充電中は charging-led を点灯、ペアリング中は pairing-led を点滅する。

compatible: "zmk,mt41rp-status-leds"

properties:
  chg-gpios:
    type: phandle-array
    required: true
    description: 充電 IC の CHG 出力（充電中にアクティブ）

  charging-led:
    type: phandle
    required: true
    description: 充電中に点灯する gpio-leds の子ノード

  pairing-led:
    type: phandle
    required: true
    description: ペアリング中に点滅する gpio-leds の子ノード
```
